## dts/bindings/pwm/renesas,rzg3s-poeg.yaml
```yaml
# Copyright (c) 2024, EPAM Systems
# SPDX-License-Identifier: Apache-2.0

description: Renesas RZ G3S POEG driver for GPT

compatible: "renesas,rzg3s-poeg"

include: [base.yaml, pinctrl-device.yaml, reset-device.yaml]

properties:
  reg:
    required: true

  interrupts:
    required: true

  clocks:
    required: true

  renesas,invert:
    type: int
    enum:
      - 0
      - 1
    description: |
      Sets output request level of the external source. When external
      pin initial state is high then ivertion should be made to raise
      output request on low state.
```

## dts/bindings/pwm/renesas,rzg3s-pwm.yaml
```yaml
# Copyright (c) 2024, EPAM Systems
# SPDX-License-Identifier: Apache-2.0

description: Renesas RZ G3S general purpose PWM timer channel

compatible: "renesas,rzg3s-pwm"

include: ["renesas,rza2m-pwm.yaml", reset-device.yaml]

properties:
  resets:
    required: true

  renesas,poeg:
    type: string
    enum:
      - "POEGA"
      - "POEGB"
      - "POEGC"
      - "POEGD"
    description: |
      Associated POEG device name choice. Should be set if
      `renesas,poeg-device` phandle was provided.

  renesas,disable-requests:
    type: int
    description: |
      Sets the Output-disable requests from POEG.
      Possible values are:
       - PWM_HIGH to sends output-disable requests if both GTIOCA and
         GTICB are in HIGH state
       - PWM_LOW to sends output-disable requests if both GTIOCA and
         GTICB are in LOW state
       - PWM_DT to sends output-disable requests if deadtime error occurred.

  renesas,poeg-device:
    type: phandle
    description: |
      Link to the POEG device which controls GPT channel
      This phandle should be set if `renesas,poeg` property was provided.
```

## dts/bindings/reset/renesas,r9a08g045-cpg-reset.yaml
```yaml
# Copyright (c) 2024 EPAM Systems
# SPDX-License-Identifier: Apache-2.0

description: |
  Renesas RZ/G3S R9A08G045 SoC CPG Reset controller.
  It has to be a subnode of the Renesas RZ/G3S R9A08G045 SoC CPG clock-controller node
  ("renesas,r9a08g045-cpg-mssr").

compatible: "renesas,r9a08g045-cpg-reset"

include: [reset-controller.yaml, base.yaml]

properties:
  "#reset-cells":
    const: 1

reset-cells:
  - id
```

## dts/bindings/rtc/renesas,rza2m-rtc.yaml
```yaml
# Copyright (c) 2023 EPAM Networks
# SPDX-License-Identifier: Apache-2.0

description: Renesas RZ A2M RTC

compatible: "renesas,rza2m-rtc"

include: [rtc-device.yaml]

properties:
  reg:
    required: true
  clocks:
    required: true
  interrupts:
    required: true
```

## dts/bindings/serial/renesas,rza2m-sci.yaml
```yaml
description: Renesas RZ/A2M UART

compatible: "renesas,rza2m-sci"

include: [uart-controller.yaml, pinctrl-device.yaml]

properties:
  reg:
    required: true

  interrupts:
    required: true

  clocks:
    description: |
      Clock source for calculating BRR value

  dmas:
    description: |
      Optional TX & RX dma specifiers. Mandatory if defined CONFIG_UART_ASYNC_API
      Each specifier will have a phandle reference to the dmac controller,
      the channel number, slot and config.

      For example dmas for TX, RX on scif3
         dmas = <&dma0 5 DMA_RS_SCI_TXI0 0>, <&dma0 6 DMA_RS_SCI_RXI0 0>;

  dma-names:
    description: |
      Required if the dmas property exists.  This should be "tx" and "rx"
      to match the dmas property.

      For example
         dma-names = "tx", "rx";

  usart-mode:
    type: boolean
    description:
      Optional boolean parameter which turns on Clock Synchronous mode

  external-clock:
    type: boolean
    description:
      This parameter actual only in Clock Synchronous mode. Use external
      source as clock
```

## dts/bindings/serial/renesas,rza2m-scif.yaml
```yaml
description: Renesas RZ/A2M UART

compatible: "renesas,rza2m-scif"

include: [uart-controller.yaml, pinctrl-device.yaml]

properties:
  reg:
    required: true

  interrupts:
    required: true

  current-speed:
    required: true
    description: |
      Initial baud rate setting for UART. Only a fixed set of baud
      rates are selectable on these devices.
    enum:
      - 4800
      - 9600
      - 14400
      - 19200
      - 28800
      - 38400
      - 57600
      - 115200
      - 230400
      - 500000
      - 921600
      - 1000000
      - 2000000

  clocks:
    description: |
      Clock source for calculating BRR value

  dmas:
    description: |
      Optional TX & RX dma specifiers. Mandatory if defined CONFIG_UART_ASYNC_API
      Each specifier will have a phandle reference to the dmac controller,
      the channel number, slot and config.

      For example dmas for TX, RX on scif3
         dmas = <&dma0 5 DMA_RS_TXI3 0>, <&dma0 6 DMA_RS_RXI3 0>;

  dma-names:
    description: |
      Required if the dmas property exists.  This should be "tx" and "rx"
      to match the dmas property.

      For example
         dma-names = "tx", "rx";
```

## dts/bindings/spi/renesas,rza2m-spi.yaml
```yaml
# Copyright (c) 2023 EPAM Systems
# SPDX-License-Identifier: Apache-2.0

description: Renesas RZ/A2M SPI

compatible: "renesas,rspi-rz"

include: [spi-controller.yaml, pinctrl-device.yaml]

properties:
  reg:
    required: true

  interrupts:
    required: true

  interrupt-names:
    required: true

  clocks:
    required: true

  num-cs:
    type: int
    description: |
      Total number of native chip selects.
      Hardware limitations related to chip selects:
        - When using GPIO chip selects, at least one native chip select must
          be left unused, as it will be driven anyway.
```

## dts/bindings/timer/renesas,ostm-rzg3s.yaml
```yaml
# Copyright (c) 2024 EPAM Systems
# SPDX-License-Identifier: Apache-2.0

description: Renesas OS timer

compatible: "renesas,ostm-r9a08g045-timer"

include: ["renesas,ostm.yaml", reset-device.yaml]

properties:
  resets:
    required: true
```

## dts/bindings/timer/renesas,ostm.yaml
```yaml
description: Renesas OS timer

compatible: "renesas,ostm-timer"

include: base.yaml

properties:
  reg:
    required: true

  clocks:
    required: true

  interrupts:
    required: true
```

## dts/bindings/usb/renesas,rza2-usbd.yaml
```yaml
# Copyright (c) 2023 EPAM Systems
# SPDX-License-Identifier: Apache-2.0

description: RZ/A2 USB device controller driver

compatible: "renesas,rza2-usbd"

include: [base.yaml, usb-ep.yaml, pinctrl-device.yaml]

properties:
  reg:
    required: true

  reg-names:
    required: true

  pinctrl-names:
    required: true

  pinctrl-0:
    required: true

  clocks:
    required: true

  clock-names:
    required: true

  interrupts:
    required: true

  interrupt-names:
    required: true
```

## dts/bindings/watchdog/renesas,rzg-wdt.yaml
```yaml
# Copyright (c) 2024 EPAM Systems
# SPDX-License-Identifier: Apache-2.0

description: Renesas RZ/G Watchdog

compatible: "renesas,rzg-wdt"

include: [base.yaml, reset-device.yaml]

properties:
  reg:
    required: true

  clocks:
    required: true

  timer-idx:
    type: int
    required: true
    description: |
      Index of watchdog timer channel index (1 or 2).
      Watchdog channel 1 checking the operation of Cortex-M33 CPU
      and channel 2 checking the operation of Cortex-M33 CPU
      with FPU. Each channel should be provided with the
      corresponding clocks and resets that are controlling
      this channel.
    enum:
      - 1
      - 2

  resets:
    required: true
```

## samples/drivers/i2s/wm8978/dts/bindings/wolfson,wm8978.yaml
```yaml
# Copyright (c) 2023 EPAM Systems
# SPDX-License-Identifier: Apache-2.0

description: Wolfson WM8978 Codec

compatible: "wolfson,wm8978"

include: [base.yaml, spi-device.yaml, pinctrl-device.yaml]

properties:
  reg:
    required: true
```

## samples/drivers/i2s/wm8978/sample.yaml
```yaml
sample:
  name: WM8978 sample
tests:
  sample.drivers.i2s.wm8978:
    tags: wm8978
    filter: dt_nodelabel_enabled("codec")
    integration_platforms:
      - rz_a2m
    harness: console
    harness_config:
      type: multi_line
      ordered: true
      regex:
        - "wm8978 sample"
        - "Exiting"
```

## samples/sensor/ina219/boards/rz_a2m.conf
```kconfig
# Copyright (c) 2023 EPAM Systems
# SPDX-License-Identifier: Apache-2.0

CONFIG_I2C_RIIC_DMA_DRIVEN=y
```

## samples/sensor/ina219/sample.yaml
```yaml
#
# Copyright (c) 2021 Leonard Pollak
#
# SPDX-License-Identifier: Apache-2.0


sample:
  name: TI INA219 power/current monitor
  description: Demonstration of the INA219 I2C power/current monitor
tests:
  sample.sensor.ina219:
    build_only: true
    platform_allow: blackpill_f411ce, rz_a2m
    tags: sensors
```

## samples/sensor/ina219_2sensors/sample.yaml
```yaml
#
# Copyright (c) 2021 Leonard Pollak
# Copyright (c) 2023 EPAM Systems
#
# SPDX-License-Identifier: Apache-2.0


sample:
  name: Sample for parallel reading of two INA219 current sensors
  description: Demonstration of the parallel data reading from 2 INA219 sensors on the same I2C bus
tests:
  sample.sensor.ina219_2sensors:
    build_only: true
    platform_allow: rz_a2m
    tags: sensors
```

## samples/subsys/input/ft5316/boards/rz_a2m.conf
```kconfig
CONFIG_I2C=y
CONFIG_LOG_DEFAULT_LEVEL=2
CONFIG_INPUT_FT5336_INTERRUPT=y
CONFIG_DYNAMIC_INTERRUPTS=y
```

## samples/subsys/input/ft5316/sample.yaml
```yaml
sample:
  name: FT5316
tests:
  sample.input.ft5316:
    tags: input
    build_only: true
    integration_platforms:
      - rz_a2m
```

## soc/arm/renesas_rz/rz_g/Kconfig.defconfig.series
```kconfig
# Renesas RZ G3S SoC line

# Copyright (c) 2024 EPAM Systems
# SPDX-License-Identifier: Apache-2.0

if SOC_SERIES_RZ_G

config SOC_SERIES
	default "rz_g"

config NUM_IRQS
	default 480

config SYS_CLOCK_HW_CYCLES_PER_SEC
	default	$(dt_node_int_prop_int,/cpus/cpu@0,clock-frequency)

config FLASH_SIZE
	default $(dt_chosen_reg_size_int,$(DT_CHOSEN_Z_FLASH),0,K)

config FLASH_BASE_ADDRESS
	default $(dt_chosen_reg_addr_hex,$(DT_CHOSEN_Z_FLASH))

endif # SOC_SERIES_RZ_G
```

## soc/arm/renesas_rz/rz_g/Kconfig.series
```kconfig
# Copyright (c) 2024 EPAM Systems
# SPDX-License-Identifier: Apache-2.0

config SOC_SERIES_RZ_G
	bool "Renesas RZ G3S series based on Cortex M33"
	select ARM
	select CPU_CORTEX_M33
	select CPU_HAS_ARM_MPU
	select SOC_FAMILY_RZ
	select CPU_HAS_CUSTOM_FIXED_SOC_MPU_REGIONS
	select CPU_HAS_ARM_SAU
	help
	  Enable support for Renesas RZ G SoC series based on Cortex M33

if SOC_SERIES_RZ_G

config NULL_POINTER_EXCEPTION_DETECTION_MPU_RZ_G
	bool "Use MPU for null pointer exception detection for RZ G3S SoC"
	depends on NULL_POINTER_EXCEPTION_DETECTION_MPU
	default y
	help
	  Null pointer dereference detection implemented using MPU functionality as
	  defined for NULL_POINTER_EXCEPTION_DETECTION_MPU, but taking into account that for RZ G3S
	  the code section is not started from 0x0 address. In this case, there is no MPU section
	  mapped for area [0x0, CORTEX_M_NULL_POINTER_EXCEPTION_PAGE_SIZE] and
	  CONFIG_FLASH_BASE_ADDRESS not started from 0x0.
	  For RZ G3S SoC the custom section added to the SoC specific MPU regions table which
	  covers area  [0x0, CORTEX_M_NULL_POINTER_EXCEPTION_PAGE_SIZE], then ARM MPU core adds
	  the same section once more to create MPU section overlap and so provide
	  null-pointer dereferencing mechanism.

endif # SOC_SERIES_RZ_G
```

## soc/arm64/renesas_rcar/Kconfig
```kconfig
# Renesas R-Car SoC line

# Copyright (c) 2023 EPAM Systems
# SPDX-License-Identifier: Apache-2.0

config SOC_FAMILY_RCAR_ARM64
	bool

if SOC_FAMILY_RCAR_ARM64

config SOC_FAMILY
	string
	default "renesas_rcar"

source "soc/arm64/renesas_rcar/*/Kconfig.soc"

endif # SOC_FAMILY_RCAR_ARM64
```

## soc/arm64/renesas_rcar/gen3/Kconfig.soc
```kconfig
# Copyright (c) 2023 EPAM Systems
# SPDX-License-Identifier: Apache-2.0

choice
	prompt "Renesas RCar SoC Selection"
	depends on SOC_SERIES_RCAR_GEN3_ARM64

config SOC_R8A7795
	bool "R8A7795"

endchoice
```

## tests/drivers/bsc/rz_a2m/testcase.yaml
```yaml
tests:
  drivers.bsc.rz_a2m:
    tags:
      - drivers
      - bsc
    depends_on:
      - bsc
      - rz_a2m
```

## tests/drivers/can/api/testcase.yaml
```yaml
tests:
  drivers.can.api:
    tags:
      - drivers
      - can
    depends_on: can
    filter: dt_chosen_enabled("zephyr,canbus") and not dt_compat_enabled("kvaser,pcican")
  drivers.can.api.twai:
    tags:
      - drivers
      - can
    extra_args: DTC_OVERLAY_FILE=twai-enable.overlay
    filter: dt_compat_enabled("espressif,esp32-twai")
    platform_allow:
      - esp32_devkitc_wroom
      - esp32_devkitc_wrover
      - esp32c3_devkitm
      - esp32s2_saola
      - esp32s3_devkitm
      - xiao_esp32s3
  drivers.can.api.rz_g3s:
    tags:
      - drivers
      - can
    depends_on: can
    extra_args: SNIPPET="rz-g3s-canfd0-test"
    platform_allow:
      - rz_g3s
```

## tests/drivers/can/timing/testcase.yaml
```yaml
tests:
  drivers.can.timing:
    tags:
      - drivers
      - can
    depends_on: can
    filter: dt_chosen_enabled("zephyr,canbus")
  drivers.can.timing.rz_g3s:
    tags:
      - drivers
      - can
    depends_on: can
    extra_args: SNIPPET="rz-g3s-canfd0-test"
    platform_allow:
      - rz_g3s
```
