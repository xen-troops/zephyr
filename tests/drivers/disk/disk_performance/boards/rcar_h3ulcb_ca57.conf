## tests/drivers/disk/disk_performance/boards/rcar_h3ulcb_ca57.conf
```kconfig
#
# Copyright (c) 2023 EPAM Systems
#
# SPDX-License-Identifier: Apache-2.0
#

CONFIG_RCAR_MMC=y
CONFIG_SDHC=y
CONFIG_MMC_RCA=1
```

## tests/drivers/pwm/poeg_api/testcase.yaml
```yaml
tests:
  drivers.poeg:
    tags:
      - drivers
      - pwm
    filter: dt_alias_exists("pwm-0")
    depends_on: pwm
```

## tests/drivers/pwm/pwm_ab/testcase.yaml
```yaml
tests:
  drivers.pwm:
    tags:
      - drivers
      - pwm
      - userspace
    filter: dt_alias_exists("pwm-0")
    depends_on: pwm
```

## tests/drivers/spi/spi_loopback/boards/rz_a2m.conf
```kconfig
# Copyright (c) 2023 EPAM Systems
# SPDX-License-Identifier: Apache-2.0

CONFIG_SPI_LOOPBACK_MODE_LOOP=y
```

## tests/drivers/spi/spi_loopback/boards/rz_g3s.conf
```kconfig
# Copyright (c) 2024 EPAM Systems
# SPDX-License-Identifier: Apache-2.0

CONFIG_SPI_LOOPBACK_MODE_LOOP=y
# TODO: Enable SPI ASYNC API after implementing DMA
CONFIG_SPI_ASYNC=n
```

## tests/drivers/spi/spi_loopback/boards/rz_g3s_fpu.conf
```kconfig
# Copyright (c) 2024 EPAM Systems
# SPDX-License-Identifier: Apache-2.0

CONFIG_SPI_LOOPBACK_MODE_LOOP=y
CONFIG_SPI_ASYNC=y
```
