## drivers/i2c/Kconfig.renesas
```kconfig
# Renesas I2C configuration options

# Copyright (c) 2023 EPAM Systems
# Copyright (c) 2021 IoT.bzh
# SPDX-License-Identifier: Apache-2.0

config I2C_RIIC
	bool "Renesas I2C Driver for RZ/A2M"
	default y
	depends on DT_HAS_RENESAS_RIIC_ENABLED
	help
	  Enable Renesas I2C Driver (RIIC) for RZ/A2M.

config I2C_RIIC_DMA_DRIVEN
	bool "DMA support for RIIC I2C devices"
	depends on I2C_RIIC
	select DMA
	help
	  This enables DMA driven transactions for the I2C peripheral.
	  DMA driven mode requires fewer interrupts to handle the
	  transaction and ensures that high speed modes are not delayed
	  by data reloading.

config I2C_RCAR
	bool "Renesas R-Car I2C Driver"
	default y
	depends on DT_HAS_RENESAS_RCAR_I2C_ENABLED
	help
	  Enable Renesas R-Car I2C Driver.
```

## drivers/i2s/Kconfig.renesas
```kconfig
# Renesas SSIF2 driver configuration options

# Copyright (c) 2023 EPAM Systems
# SPDX-License-Identifier: Apache-2.0

config I2S_RENESAS_SSIF2
	bool "SSIF controller driver"
	default y
	depends on DT_HAS_RENESAS_SSIF2_ENABLED
	select DMA
	help
	  Enable I2S support on the RZ/A2M family of processors.

if I2S_RENESAS_SSIF2

config I2S_RENESAS_SSIF_RX_BLOCK_COUNT
	int "RX queue length"
	default 4

config I2S_RENESAS_SSIF_TX_BLOCK_COUNT
	int "TX queue length"
	default 4

endif # I2S_RENESAS_SSIF2
```

## drivers/pinctrl/Kconfig.rzg3s
```kconfig
# opyright (c) 2024 EPAM Systems
# SPDX-License-Identifier: Apache-2.0

config PINCTRL_RZG3S
	bool "Pin controller driver for Renesas RZ G3S series"
	default y
	depends on DT_HAS_RENESAS_R9A08G045_CPG_MSSR_ENABLED
	help
	  Enable pin controller driver for Renesas RZ G3S series

if PINCTRL_RZG3S

config PINCTRL_RZG3S_INIT_PRIORITY
	int "RZ G3S pinctrl init priority"
	default 35
	help
	  Device driver initialization priority.

endif #PINCTRL_RZG3S
```
