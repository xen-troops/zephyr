## boards/arm/rz_a2m/rz_a2m_defconfig
```kconfig
CONFIG_SOC_R7S9210=y
CONFIG_SOC_SERIES_RZ_A=y
CONFIG_BOARD_RZ_A2M=y

# dummy value, runtime value will be used from 'renesas,ostm' timer driver
CONFIG_SYS_CLOCK_HW_CYCLES_PER_SEC=33000000

CONFIG_MULTI_LEVEL_INTERRUPTS=y

# Enable clock control
CONFIG_CLOCK_CONTROL=y

# Enable UART driver
CONFIG_SERIAL=y

# Enable PINCTRL driver
CONFIG_PINCTRL=y

# Enable GPIO driver
CONFIG_GPIO=y
# RZ/A2M Driver doesn't support irq reconfiguration, just set ISEL bit
CONFIG_GPIO_ENABLE_DISABLE_INTERRUPT=y

# Enable console
CONFIG_CONSOLE=y
CONFIG_UART_CONSOLE=y

# Enable Cache Management to be support inv_range and flush_range calls
# needed for DMA to work correctly.
CONFIG_CACHE_MANAGEMENT=y

# Enable BSC
CONFIG_BSC=y

# Enable RSPI
CONFIG_SPI_RZA2M=y
```

## boards/arm/rz_g3s/Kconfig.board
```kconfig
# Copyright (c) 2024 EPAM Systems
# SPDX-License-Identifier: Apache-2.0

config BOARD_RZ_G3S
	bool "Cortex-M33 for Renesas RZ G3S"
	depends on SOC_R9A08G045

config BOARD_RZ_G3S_FPU
	bool "Cortex-M33 with FPU for Renesas RZ G3S"
	select CPU_HAS_FPU
	depends on SOC_R9A08G045
```

## boards/arm/rz_g3s/Kconfig.defconfig
```kconfig
# Copyright (c) 2024 EPAM Systems
# SPDX-License-Identifier: Apache-2.0

if BOARD_RZ_G3S
config BOARD
	default "rz_g3s"

endif # BOARD_RZ_G3S

if BOARD_RZ_G3S_FPU
config BOARD
	default "rz_g3s_fpu"

config FPU
	default y

config FPU_SHARING
	default y
endif # BOARD_RZ_G3S_FPU
```

## boards/arm/rz_g3s/rz_g3s_defconfig
```kconfig
CONFIG_SOC_R9A08G045=y
CONFIG_SOC_SERIES_RZ_G=y
CONFIG_BOARD_RZ_G3S=y

CONFIG_SYS_CLOCK_EXISTS=y

CONFIG_XIP=n

CONFIG_ARM_MPU=y

# Enable clock control
CONFIG_CLOCK_CONTROL=y
CONFIG_RESET=y

# Enable System Controller driver
CONFIG_SYSCON=y

CONFIG_MAIN_STACK_SIZE=4096

# Enable PINCTRL driver
CONFIG_PINCTRL=y

# Enable UART driver
CONFIG_SERIAL=y

# Enable console
CONFIG_CONSOLE=y
CONFIG_UART_CONSOLE=y

# Enable GPIO driver
CONFIG_GPIO=y

CONFIG_MULTI_LEVEL_INTERRUPTS=y
CONFIG_DYNAMIC_INTERRUPTS=y

#this is required to enable debug with xSPI boot when Zephyr already booted by TF-A
#and MPU configured which prevent running debug code with exception
CONFIG_INIT_ARCH_HW_AT_BOOT=y
CONFIG_PLATFORM_SPECIFIC_INIT=n
```

## boards/arm64/rpi_5/Kconfig.defconfig
```kconfig
# Copyright 2023 honglin leng <a909204013@gmail.com>
# SPDX-License-Identifier: Apache-2.0

config BOARD
	default "Raspberry Pi 5"
	depends on BOARD_RPI_5
```

## boards/arm64/rpi_5/rpi_5_defconfig
```kconfig
# SPDX-License-Identifier: Apache-2.0

CONFIG_SOC_BCM2712=y
CONFIG_BOARD_RPI_5=y
CONFIG_ARM64_VA_BITS_40=y
CONFIG_ARM64_PA_BITS_40=y
CONFIG_TIMER_READS_ITS_FREQUENCY_AT_RUNTIME=y

# Enable serial console.
CONFIG_SERIAL=y
CONFIG_CONSOLE=y
CONFIG_UART_CONSOLE=y
```

## boards/arm64/xenvm/xenvm-qemu_defconfig
```kconfig
CONFIG_SOC_XENVM=y
CONFIG_BOARD_XENVM=y
CONFIG_XEN_INITIAL_DOMAIN=y

# Enable UART driver
CONFIG_SERIAL=y

CONFIG_XIP=n
CONFIG_FLASH_BASE_ADDRESS=0x0
CONFIG_FLASH_SIZE=0
CONFIG_AARCH64_IMAGE_HEADER=y
CONFIG_MAX_XLAT_TABLES=10
CONFIG_HEAP_MEM_POOL_SIZE=262144

# Enable console
CONFIG_CONSOLE=y
CONFIG_UART_CONSOLE=y

# Enable PV hypervisor console
#CONFIG_UART_CONSOLEIO_XEN_HVC=y

# Enable logging subsys
CONFIG_LOG=y
CONFIG_LOG_MODE_MINIMAL=n

CONFIG_TEST=y
#CONFIG_PRINTK_SYNC=y

CONFIG_SHELL=y
CONFIG_SHELL_BACKEND_SERIAL=y

CONFIG_FLASH=y
CONFIG_FLASH_SHELL=y
CONFIG_FLASH_SIMULATOR=y

CONFIG_FILE_SYSTEM=y
CONFIG_FILE_SYSTEM_SHELL=y
CONFIG_FILE_SYSTEM_LITTLEFS=y

CONFIG_FLASH_MAP=y
CONFIG_FLASH_PAGE_LAYOUT=y
CONFIG_MPU_ALLOW_FLASH_WRITE=y
```

## boards/shields/xendom0/Kconfig.shield
```kconfig
# Copyright (c) 2023 EPAM
# SPDX-License-Identifier: Apache-2.0

config SHIELD_XENDOM0
	def_bool $(shields_list_contains,xendom0)
```

## boards/shields/xendom0/xendom0_gen4_defconfig
```kconfig
CONFIG_XENVM_USE_GIC_V3=y

# Enable PV hypervisor console
CONFIG_UART_XEN_HVC_CONSOLEIO=y
```

## drivers/adc/Kconfig.renesas
```kconfig
# ADC configuration options

# Copyright (c) 2023 Renesas Electronics Corporation
# SPDX-License-Identifier: Apache-2.0

config ADC_SMARTBOND_GPADC
	bool "Renesas SmartBond(tm) ADC driver for ADC"
	default y
	depends on DT_HAS_RENESAS_SMARTBOND_ADC_ENABLED
	select ADC_CONFIGURABLE_INPUTS
	help
	  Enable support for ADC driver for Renesas SmartBond(tm) MCU series.

config ADC_SMARTBOND_SDADC
	bool "Renesas SmartBond(tm) ADC driver for Sigma-Delta ADC"
	default y
	depends on DT_HAS_RENESAS_SMARTBOND_SDADC_ENABLED
	select ADC_CONFIGURABLE_INPUTS
	help
	  Enable support for ADC driver for Renesas SmartBond(tm) MCU series.

config ADC_RZG3S
	bool "Renesas RZ/G3S ADC Interface"
	default y
	depends on SOC_R9A08G045
	depends on DT_HAS_RENESAS_RZG3S_ADC_ENABLED
	help
	  Enables support for ADC driver for Renesas RZ/A2M series SoC.
```

## drivers/bsc/Kconfig
```kconfig
# Copyright 2023 EPAM Systems
# SPDX-License-Identifier: Apache-2.0

menuconfig BSC
	   bool "BSC drivers"
	   help
	     The bus state controller outputs control signals
	     for various types of memory and external devices
	     that are connected to the external address space.

if BSC

source "drivers/bsc/Kconfig.rza2"

endif #BSC
```

## drivers/bsc/Kconfig.rza2
```kconfig
# Copyright 2023 EPAM Systems
# SPDX-License-Identifier: Apache-2.0

config BSC_RZA2
	bool "BSC driver for RZ/A2 series"
	default y
	depends on DT_HAS_RENESAS_RZA2_BSC_ENABLED
	help
	 Enable support for BSC driver for RZ/A2 series.

if BSC_RZA2

config BSC_RZA2_INIT_PRIORITY
	int "RZA2 BSC init priority"
	default 40
	help
	  Device driver initialization priority.

endif # BSC_RZA2
```

## drivers/can/Kconfig.rzg3s
```kconfig
# Renesas RZ G3S CAN-FD configuration options
#
# Copyright (c) 2024 EPAM Systems
# SPDX-License-Identifier: Apache-2.0

config CAN_RZGS_FD
	bool "Renesas RZ G3S CAN-FD Driver"
	default y
	depends on CAN_FD_MODE
	depends on DT_HAS_RENESAS_RZG3S_CANFD_ENABLED
	help
	  Enable Renesas RZ G3S CAN-FD Driver.

if CAN_RZGS_FD

config CAN_MAX_FILTER
	int "Maximum number of concurrent active RX filters"
	depends on CAN_RZGS_FD
	default 32
	range 1 128
	help
	  Defines the Maximum number of concurrent active RX filters and the array size of
	  the callback/msgq pointers.
	  For RZ G3S Soc the CAN_MAX_FILTER defines number of AFL entries per channel.
	  All CAN-FD channels will use the same number of AFL entries.

config CAN_RZGS_FD_MAX_RX
	int "Maximum number of RX FIFO buffers"
	depends on CAN_RZGS_FD
	default 32
	range 4 64
	help
	  Maximum number of RX FIFO buffers.
	  Allowed values: 4, 8, 16, 32, 48, 64, 128.
	  All CAN-FD channels will use the same number of RX FIFO buffers.

config CAN_RZGS_FD_MAX_RX_DATA_SIZE
	int "Maximum size of RX Payload Data Size"
	depends on CAN_RZGS_FD
	default 64
	range 8 64
	help
	  Maximum size of RX packet payload data size used for RZ G3S RX FIFO.
	  Allowed values: 8, 12, 16, 20, 24, 32, 48, 64
	  All CAN-FD channels will use the same maximum size of RX packet payload data.

config CAN_RZGS_FD_MAX_TX
	int "Maximum number of TX message buffers"
	depends on CAN_RZGS_FD
	default 32
	range 1 32
	help
	  Maximum number of TX message buffers.
	  All CAN-FD channels will use the same number of TX message buffers.


config CAN_RZG3S_CHN_INIT_PRIORITY
	int "Renesas RZ G3S GPIO controller init priority"
	default 81
	depends on CAN_RZGS_FD
	help
	  The RZ G3S CAN channel driver initialization priority. The priority should be lower
	  than CAN_INIT_PRIORITY device.

endif # CAN_RZGS_FD
```

## drivers/clock_control/Kconfig.renesas
```kconfig
# Copyright (c) 2021-2022 IoT.bzh
# Copyright (c) 2024 EPAM Systems
# SPDX-License-Identifier: Apache-2.0

config CLOCK_CONTROL_RENESAS_CPG_MSSR
	bool "Renesas CPG MSSR driver"
	default y
	depends on DT_HAS_RENESAS_R8A7795_CPG_MSSR_ENABLED || DT_HAS_RENESAS_R7S9210_CPG_MSSR_ENABLED
	help
	  Enable support for Renesas RCar CPG MSSR driver.

config CLOCK_CONTROL_RENESAS_RZG3S
	bool "Renesas RZ/G3S family clock support"
	default y
	depends on DT_HAS_RENESAS_R9A08G045_CPG_MSSR_ENABLED
	depends on CLOCK_CONTROL
	help
	  Enable support for Renesas RZ/G3S CPG Clock Pulse Generator (CPG) driver.
	  The CPG driver supports only module's clocks.
	  The PLLs and core clocks are not configured by the CPG driver.
```

## drivers/counter/Kconfig.rz
```kconfig
# Copyright (c) 2024 EPAM Systems
# SPDX-License-Identifier: Apache-2.0

config COUNTER_RZ_GTM_COUNTER
	bool "Renesas RZ General Timer (GTM) Counter driver"
	default y
	depends on DT_HAS_RENESAS_OSTM_ENABLED
	help
	  This module implements a kernel Counter driver for the Renesas RZ A2M/G3S
	  General Timer (GTM/OSTM).
```

## drivers/disk/Kconfig.ram
```kconfig
# Copyright (c) 2016 Intel Corporation
# SPDX-License-Identifier: Apache-2.0

config DISK_DRIVER_RAM
	bool "RAM Disk"
	help
	  RAM buffer used to emulate storage disk.
	  This option can be used to test the file
	  system.

if DISK_DRIVER_RAM

config DISK_RAM_VOLUME_SIZE
	int "RAM Disk size in kilobytes"
	default 96
	help
	  Size of the RAM Disk. If compression is supported, this
	  is the maximum size of the uncompressed RAM Disk.

config DISK_RAM_VOLUME_NAME
	string "RAM Disk mount point or drive name"
	default "RAM"
	help
	  Disk name as per file system naming guidelines.

config DISK_RAM_EXTERNAL
	bool "Use initrd provided by the bootloader"
	help
	  Use the initrd provided by the bootloader as the RAM Disk.

config DISK_RAM_START
	hex "Start address of the preloaded RAM Disk"
	depends on DISK_RAM_EXTERNAL
	default 0
	help
	  Start the RAM Disk at a specific address.

config DISK_RAM_DECOMPRESS
	bool "Decompress the initrd"
	depends on DISK_RAM_EXTERNAL && LZ4
	help
	  Decompress the initrd before using it as the RAM Disk.

module = RAMDISK
module-str = ramdisk
source "subsys/logging/Kconfig.template.log_config"

endif # DISK_DRIVER_RAM
```

## drivers/dma/Kconfig.rza2
```kconfig
# Copyright (c) 2023 EPAM Systems
# SPDX-License-Identifier: Apache-2.0

config DMA_RZA2
	bool "Renesas RZA2 General Purpose DMA driver"
	depends on DT_HAS_RENESAS_RZA2_DMA_ENABLED
	select NOCACHE_MEMORY
	default y
	help
	  General Purpose DMA for Renesas RZA2 series. Please note that the buffers
	  for DMA should be provided with care or placed in NOCACHE_MEMORY section
	  to avoid cache coherence issues that can not be solved using cache maintenance
	  operations.
	  Using cacheble buffers for transfer is possible when buffers follows a set of rules:
	  - ensure the I/O buffers are cacheline-aligned. Without that, cacheline
	    sharing problems (data corruption) on CPUs with DMA-incoherent caches can be seen.
	    (The CPU could write to one word, DMA would write to a different one
	    in the same cache line, and one of them could be overwritten.)
	  - use cache maintenance operations to ensure that cache is coherent before and after the
	    transaction.

if DMA_RZA2

config DMA_RZA2_DESCRS_CHUNKS
	int "Dma RZA2 maximum descriptor pool chunks"
	default 16
	help
	  When RZ/A2 DMAC works in Link Mode, it accepts a linked list of descriptors that
	  includes information about data blocks to transfer. Zephyr recommends avoiding
	  the use of HEAP for data allocation; that's why this driver uses a preallocated
	  pool for the descriptors. This configuration specifies the maximum number of chunks
	  (chunk can be used as pool for each channel).

config DMA_RZA2_MAX_DESCRS
	int "Dma RZA2 maximum descriptors per channel"
	default 4
	help
	  This configuration describes the number of descriptors per allocated chunk (see
	  DAM_RZA2_DESCRS_CHUNKS for details) that can be assigned to each channel.
	  During the configuration, descriptors are connected to the linked list, which
	  is then passed to the DMA for performing the transfer.

config DMA_RZA2_INIT_PRIORITY
	int "Dma RZA2 init priority"
	default 41
	help
	  Dma driver init priority.

endif # DMA_RZA2
```

## drivers/ethernet/Kconfig.renesas
```kconfig
# Renesas Ethernet Controller (ETHERC) configuration options
# Copyright (c) 2023 EPAM Systems
# SPDX-License-Identifier: Apache-2.0

menuconfig ETH_RZA2M
	bool "Renesas RZ/A2M Ethernet controller support"
	depends on SOC_R7S9210
	depends on DT_HAS_RENESAS_ETHER_R7S9210_ENABLED
	select NOCACHE_MEMORY
	default n
	help
	  Renesas Ethernet device driver for
	  SOC RZ/A2M R7S9210 Ethernet Controller (ETHERC).

if ETH_RZA2M

config ETH_RZA2M_DESC_ALIGN_SIZE
	int "Transmit/Receive Descriptor Length, bytes"
	default 16
	range 16 64

config ETH_RZA2M_NB_TX_DESCS
	int "Number of entries in the transmit descriptor ring"
	default 16
	range 4 128
	help
	  A higher number allows for more packets to be queued which may
	  improve throughput, but that requires more transient memory.
	  However there must be enough descriptors to hold all fragments
	  of a full-size packet to be transmitted or the packet will be
	  dropped.

	  Fragment size is influenced by CONFIG_NET_BUF_DATA_SIZE.

config ETH_RZA2M_NB_RX_DESCS
	int "Number of entries in the receive descriptor ring"
	default 16
	range 4 128
	help
	  Received packets are spread across the required number of fragment
	  buffers. Each RX fragment has a size of CONFIG_NET_BUF_DATA_SIZE.
	  There is one descriptor entry per fragment.

	  A higher number allows for more packets to be received without
	  immediate intervention from the CPU but requires more transient
	  memory. A smaller number increases the risk of an overflow and
	  dropped packets.

endif # ETH_RZA2M
```

## drivers/firmware/arm_scmi/Kconfig
```kconfig
# Copyright (c) 2024 EPAM Systems
# SPDX-License-Identifier: Apache-2.0

menuconfig ARM_SCMI
	bool "ARM System Control and Management Interface (SCMI)"
	help
	  Include ARM SCMI drivers in system config.

if ARM_SCMI

module = ARM_SCMI
module-str = ARM_SCMI
source "subsys/logging/Kconfig.template.log_config"

config ARM_SCMI_TRANSPORT_SMC
	bool
	default y if DT_HAS_ARM_SCMI_SMC_ENABLED
	default y if DT_HAS_ARM_SCMI_SMC_PARAM_ENABLED
	help
	  Enable support of SCMI compliant firmware with ARM SMC/HVC transport
	  with/without shmem address(4KB-page, offset) as parameters

config ARM_SCMI_BASE_EXT_REV
	bool "Select to report ARM SCMI base protocol extended revision"
	default y
	help
	  Enable report of ARM SCMI base extended revision information at boot time.

choice ARM_SCMI_SMC_METHOD
	bool "Select ARM SCMI SMC Calling Convention method"
	depends on ARM_SCMI_TRANSPORT_SMC
	default ARM_SCMI_SMC_METHOD_SMC

config ARM_SCMI_SMC_METHOD_SMC
	bool "Use ARM SCMI Secure Monitor Call (SMC) method"
	help
	  Use ARM Secure Monitor Call (SMC) method to access SCMI.

config ARM_SCMI_SMC_METHOD_HVC
	bool "Use ARM SCMI Hypervisor Call (HVC) method"
	help
	  Use ARM Hypervisor Call (HVC) method to access SCMI.
endchoice

endif # ARM_SCMI
```

## drivers/flash/Kconfig.rza2
```kconfig
# Copyright (c) 2023 Epam Systems
#
# SPDX-License-Identifier: Apache-2.0

config FLASH_RZA2
	bool "Flash driver for RZ/A2 series"
	default y
	depends on DT_HAS_RENESAS_RZA2_FLASH_CONTROLLER_ENABLED
	depends on !XIP
	select FLASH_HAS_DRIVER_ENABLED
	select FLASH_HAS_PAGE_LAYOUT
	help
	  Enable flash driver for RZ/A2 series.
```

## drivers/gpio/Kconfig.rzg3s
```kconfig
# Copyright (c) 2024 EPAM Systems
# SPDX-License-Identifier: Apache-2.0

config GPIO_RZG3S
	bool "Renesas RZ G3S GPIO controller"
	default y
	depends on DT_HAS_RENESAS_R9A08G045_GPIO_ENABLED
	depends on PINCTRL
	help
	  Enable Renesas RZ G3S GPIO controller driver.

if GPIO_RZG3S

config GPIO_RZG3S_INIT_PRIORITY
	int "Renesas RZ G3S GPIO controller init priority"
	default 40
	help
	  The RZ G3S GPIO controller driver initialization priority. The priority should be lower
	  than PINCTRL_RZG3S_INIT_PRIORITY device.

config GPIO_RZG3S_PORT_INIT_PRIORITY
	int "Renesas RZ G3S GPIO controller init priority"
	default 41
	help
	  The RZ G3S GPIO port driver initialization priority. The priority should be lower
	  than GPIO_RZG3S_INIT_PRIORITY device.

endif #GPIO_RZG3S
```
