/*
 * Copyright (c) 2023 EPAM Systems
 *
 * SPDX-License-Identifier: Apache-2.0
 *
 */

#include "xenvm-qemu.dtsi"

&gic {
	reg = <0x00 0x08000000 0x00 0x10000
	       0x00 0x80a0000 0x00 0xf60000>;
};
