## drivers/pwm/Kconfig.rza2m
```kconfig
# Renesas RZ A2M general purpose PWM timer configuration options

# Copyright (c) 2023 EPAM Systems
# SPDX-License-Identifier: Apache-2.0

config PWM_RZA2M
	bool "Renesas RZ/A2M General purpose PWM timer driver"
	default y
	depends on DT_HAS_RENESAS_RZA2M_PWM_ENABLED || DT_HAS_RENESAS_RZG3S_PWM_ENABLED
	help
	  Enable General Purpose PWM timer driver. This driver is
	  compatible with both RZ/A2M and RZ/G3S boards.

config POEG_RZG3S
	bool "Renesas RZ/G3S POEG driver"
	default y
	depends on DT_HAS_RENESAS_RZG3S_POEG_ENABLED
	help
	  Enable POEG driver. This driver is compatible with
	  RZ/G3S GPT driver.

config PWM_MTU_RZA2M
	bool "Renesas RZ/A2M multi-functional PWM timer driver"
	default y
	depends on DT_HAS_RENESAS_RZA2M_MTU_ENABLED
	help
	  Enable Multi Functional PWM timer driver.
```

## drivers/reset/Kconfig.arm_scmi
```kconfig
# Copyright (c) 2024 EPAM Systems
# SPDX-License-Identifier: Apache-2.0

config ARM_SCMI_RESET
	bool "ARM SCMI based reset driver"
	depends on DT_HAS_ARM_SCMI_RESET_ENABLED
	default y
	help
	  Enable ARM SCMI reset driver based on Reset domain management protocol.

config ARM_SCMI_RESET_SHELL
	bool "ARM SCMI reset shell interface"
	depends on ARM_SCMI_SHELL
	default y
	help
	  Enable ARM SCMI reset shell interface used for testing/demo purposes.
```

## drivers/reset/Kconfig.renesas
```kconfig
# Copyright (c) 2024 EPAM Systems
# SPDX-License-Identifier: Apache-2.0

config RESET_RENESAS_RZG3S_CPG
	bool "Renesas RZ/G3S family clock support"
	default y
	depends on DT_HAS_RENESAS_R9A08G045_CPG_RESET_ENABLED
	help
	  Enable support for Renesas CPG MSSR Reset controller driver.
```

## drivers/rtc/Kconfig.rza
```kconfig
# Copyright 2023 EPAM Systems
# SPDX-License-Identifier: Apache-2.0

config RTC_RZA2M
	bool "Renesas RZ A RTC driver"
	default y
	depends on DT_HAS_RENESAS_RZA2M_RTC_ENABLED
	help
	  Build RTC driver for RZ A SoCs.
```

## drivers/serial/Kconfig.renesas
```kconfig
# Renesas SCIF UART configuration options

# Copyright (c) 2021 IoT.bzh
# Copyright (c) 2023 EPAM Systems
# SPDX-License-Identifier: Apache-2.0

config UART_SCIF
	bool "Renesas SCIF UART Driver"
	default y
	depends on DT_HAS_RENESAS_RCAR_SCIF_ENABLED || DT_HAS_RENESAS_RZA2M_SCIF_ENABLED
	select SERIAL_HAS_DRIVER
	select SERIAL_SUPPORT_INTERRUPT
	select SERIAL_SUPPORT_ASYNC if DT_HAS_RENESAS_RZA2_DMA_ENABLED
	select DMA if UART_ASYNC_API
	help
	  Enable Renesas SCIF UART Driver.

config UART_SCI
	bool "Renesas SCI UART Driver"
	default y
	depends on DT_HAS_RENESAS_RZA2M_SCI_ENABLED
	select SERIAL_HAS_DRIVER
	select SERIAL_SUPPORT_INTERRUPT
	select SERIAL_SUPPORT_ASYNC if DT_HAS_RENESAS_RZA2_DMA_ENABLED
	select DMA if UART_ASYNC_API
	help
	  Enable Renesas SCI UART Driver.
```

## drivers/spi/Kconfig.renesas
```kconfig
# Copyright (c) 2022 Renesas Electronics Corporation
# Copyright (c) 2023 EPAM Systems
# SPDX-License-Identifier: Apache-2.0

config SPI_SMARTBOND
	bool "Renesas SmartBond(tm) SPI driver"
	default y
	depends on DT_HAS_RENESAS_SMARTBOND_SPI_ENABLED
	help
	  Enables SPI driver for Renesas SmartBond(tm) DA1469x series MCU.

config SPI_RZA2M
	bool "Renesas RZ/A2M Serial Peripheral Interface"
	default y
	depends on SOC_R7S9210
	depends on DT_HAS_RENESAS_RSPI_RZ_ENABLED
	help
	  Enables SPI driver for Renesas Serial Peripheral Interface on RZ/A2M series SoC.
```

## drivers/usb/device/Kconfig.renesas
```kconfig
# Copyright (c) 2023 EPAM Systems
# SPDX-License-Identifier: Apache-2.0

config USB_DC_RZA2
	bool "USB device controller driver for RZ/A2 board series"
	default y
	depends on DT_HAS_RENESAS_RZA2_USBD_ENABLED
	help
	  USB device controller driver for RZ/A2 Soc series.

if USB_DC_RZA2

config USB_DC_RZA2_STACK_SIZE
	int "USBD controller driver internal thread stack size"
	depends on USB_DC_RZA2
	default 2048
	help
	  RZ/A2 USBD device controller driver internal thread stack size.

config USB_DC_RZA2_THREAD_PRIORITY
	int "RZA2 USBD controller driver thread priority"
	depends on USB_DC_RZA2
	default 8
	help
	  RZA2 USBD device controller driver thread priority

config USBD_RZA2_MESSAGE_COUNT
	int "RZA2 USBD controller driver internal msg queue size"
	depends on USB_DC_RZA2
	default 10
	help
	  RZA2 USBD controller driver internal msg queue size

config USBD_RZA2_BULK_TRN_COUNT
	int "RZA2 USBD controller Bulk Transaction Counter value"
	depends on USB_DC_RZA2
	default 3
	help
	  RZA2 USBD controller Bulk Transaction Counter value PIPEnTRN.TRNCNT

config USBD_RZA2_BUSWAIT
	int "RZA2 USBD controller BUSWAIT value"
	depends on USB_DC_RZA2
	default 7
	help
	  RZA2 USBD controller BUSWAIT value SYSCFG1.BUSWAIT

config USBD_RZA2_USE_DMA
	bool "DMA support for USB device driver"
	default y
	help
	  RZ/A2 has internal DMA controller for USB that is part
	  of the USB controller and can be used to transfer data
	  to pipe

config USBD_RZA2_DMA_TIMEOUT
	int "Time in MSEC to wait for transaction end"
	default 50
	help
	  During usb_read operation it is waiting up to the provided value
	  before reporting busy state

endif #USB_DC_RZA2
```

## drivers/watchdog/Kconfig.rz
```kconfig
# Renesas RZ WDT configuration

# Copyright (C) 2023 EPAM Systems
# SPDX-License-Identifier: Apache-2.0

config WDT_RZA
	bool "Renesas RZA Watchdog (WDT) Driver"
	default y
	depends on DT_HAS_RENESAS_RZA_WDT_ENABLED
	depends on CLOCK_CONTROL
	help
	  Enable WDT driver for Renesas RZA.

config WDT_RZG
	bool "Renesas RZG Watchdog (WDT) Driver"
	default y
	depends on DT_HAS_RENESAS_RZG_WDT_ENABLED
	depends on CLOCK_CONTROL
	help
	  Enable WDT driver for Renesas RZG.

config WDT_RZ_INIT_PRIORITY
	int "Renesas RZ Watchdog driver initialization priority"
	depends on WDT_RZA || WDT_RZG
	default 65
	help
	  Initialization priority for the Renesas RZ Watchdog driver.
```

## dts/bindings/adc/renesas,rzg3s-adc.yaml
```yaml
# Copyright (c) 2024, EPAM Systems
# SPDX-License-Identifier: Apache-2.0

description: |
  Renesas RZ/G3S ADC controller

  "input" cell in io-channel-cells indicate the ADC input channel index.
  RZ/G3S has 8 analog inputs (ADC_CH0 to ADC_CH7) and one Thermal Sensor Unit (TSU).
  Accordingly, input can be from 0 to 8. For example io-channels for 0, 1 and 8 channel:

    / {
      zephyr,user {
        io-channels = <&adc 0>, <&adc 1>, <&adc 8>;
      };
    };

compatible: "renesas,rzg3s-adc"

include: [adc-controller.yaml, pinctrl-device.yaml, reset-device.yaml]

properties:
  reg:
    required: true

  interrupts:
    required: true

  clocks:
    required: true

  resets:
    required: true

  vref-mv:
    type: int
    default: 1800
    description: |
      Indicate the reference voltage of the ADC in mV.
      RZ/G3S has one voltage reference (ADC_AVDD18 pin).
      And it is usually connected to VDD.
      In such case, set this property to the VDD (in mV) value.

  "#io-channel-cells":
    const: 1

io-channel-cells:
  - input
```

## dts/bindings/can/renesas,rzg3s-canfd.yaml
```yaml
description: |
  Renesas RZ G3S CAN-FD controller bindings. The RZ G3S is 2-channel CAN-FD module (CAN-FD) that
  complies with ISO 11898-1 (2015) Standards. It transmits and receives both formats of messages:
  the standard identifier (11 bits) and extended ID (29 bits).
  - number of receive rules (0 to 128) for each channel
  - transmit buffers up to 32 per channel;
  - receive buffers 128 total, up to 64 buffers per channel;
  - Transmitter Delay Compensation;
  - RX/TX message timestamping.

compatible: "renesas,rzg3s-canfd"

include: [base.yaml, pinctrl-device.yaml, reset-device.yaml]

properties:
  reg:
    required: true

  interrupts:
    required: true

  clocks:
    required: true

  clock-names:
    required: true

  resets:
    required: true

  "#address-cells":
    const: 1

  "#size-cells":
    const: 0

child-binding:
  description: |
    CAN-FD controller channels

  include:
    - name: can-fd-controller.yaml
      property-blocklist:
        - compatible

  properties:
    reg:
      required: true

    sample-point:
      required: true

    sample-point-data:
      required: true

    renesas,tx-delay-comp-offset-only:
      description: |
        The only provided "tx-delay-comp-offset" is used if "tx-delay-comp-offset-only" is provided.
        RZ G3S CAN-FD controller supports Transmitter Delay Compensation (TDC) and, by default, the
        TDC is applied as "tx-delay-comp-offset" + CFDCnFDSTS.TDCR.
        Where
        - "tx-delay-comp-offset" is provided by user in CAN channel DLL clock cycles and
        stored in CFDCnFDCFG.TDCO (TDCO + 1 value is applied).
        - CFDCnFDSTS.TDCR is the measured Transceiver Delay Compensation Result
      type: boolean
```

## dts/bindings/clock/renesas,r9a08g045-cpg-mssr.yaml
```yaml
# Copyright (c) 2023 EPAM Systems
# SPDX-License-Identifier: Apache-2.0

description: |
  Renesas RZ/G3S R9A08G045 SoC Clock Pulse Generator/Module Standby and
  Software Reset controller

compatible: "renesas,r9a08g045-cpg-mssr"

include: [base.yaml, "renesas,rcar-cpg-mssr.yaml"]

properties:
  clocks:
    required: true
```

## dts/bindings/counter/renesas,ostm-counter.yaml
```yaml
# Copyright (c) 2024 EPAM Systems
# SPDX-License-Identifier: Apache-2.0
description: Renesas OS timer Counter

compatible: "renesas,ostm"

include: [base.yaml, reset-device.yaml]

properties:
  reg:
    required: true

  clocks:
    required: true

  interrupts:
    required: true
```

## dts/bindings/counter/renesas,ostm-rzg3s-counter.yaml
```yaml
# Copyright (c) 2024 EPAM Systems
# SPDX-License-Identifier: Apache-2.0
description: Renesas OS timer Counter

compatible: "renesas,ostm-r9a08g045"

include: ["renesas,ostm-counter.yaml", reset-device.yaml]

properties:
  resets:
    required: true
```

## dts/bindings/dma/renesas,rzg3-dma.yaml
```yaml
# Copyright (c) 2024, EPAM Systems
# SPDX-License-Identifier: Apache-2.0

description: |
  RZG3 DMA controller

  channel: Select channel for data transmitting

  slot: Select peripheral to connect DMA. Slots defined in rza2_dma.h header.

  config: A 32bit mask specifying the DMA channel configuration

  Example of device-tree configuration

  &ssi0 {
       status = "okay";

       dmas = <&dma0 0 DMA_RS_SSIF_DMA_RX0 0>, <&dma0 5 DMA_RS_SSIF_DMA_TX0 0>;
       dma-names = "rx", "tx";
  };

include: ["renesas,rza2-dma.yaml", base.yaml, reset-device.yaml]

compatible: "renesas,rzg3-dma"

properties:

  resets:
    required: true

  clocks:
    required: true
```

## dts/bindings/ethernet/renesas,rza2m-ethernet.yaml
```yaml
# Copyright (c) 2023 EPAM Systems
# SPDX-License-Identifier: Apache-2.0

description: Renesas Electronics RZ/A2M EtherMAC

compatible: "renesas,ether-r7s9210"

include: [ethernet-controller.yaml, pinctrl-device.yaml, "ethernet,fixed-link.yaml"]

properties:
  reg:
    required: true
    description: |
      - ETHERC registers

  interrupts:
    required: true

  '#address-cells':
    description: number of address cells for the MDIO bus
    const: 1

  '#size-cells':
    description: number of size cells on the MDIO bus
    const: 0

  clocks:
    required: true

  phy-mode:
    type: string
    enum:
      - "mii"
      - "rmii"
    description: |
      Specifies interface type between the Ethernet device and a physical
      layer (PHY) device.
    default: "rmii"
    required: true

  pinctrl-0:
    required: true
  pinctrl-names:
    required: true

  renesas,no-ether-link:
    type: boolean
    description:
      specify when a board does not provide a proper Ether LINK signal

  renesas,ether-link-active-low:
    type: boolean
    description:
      specify when the Ether LINK signal is active-low instead of normal
      active-high
```

## dts/bindings/firmware/arm,scmi-reset.yaml
```yaml
# Copyright (c) 2024 EPAM Systems
# Copyright 2021 ARM Ltd.
# SPDX-License-Identifier: Apache-2.0

description: SCMI Reset domain management Interface

compatible: "arm,scmi-reset"

include: [base.yaml, reset-controller.yaml]

properties:
  "#reset-cells":
    const: 1

  reg:
    required: true
    description: Reset domain Proto identifier 0x16
    const: [0x16]

reset-cells:
  - id
```

## dts/bindings/flash_controller/renesas,rza2-flash-controller.yaml
```yaml
# Copyright (c) 2023 Epam Systems
# SPDX-License-Identifier: Apache-2.0

description: Renesas RZ/A2 series flash controller

compatible: "renesas,rza2-flash-controller"

include: [flash-controller.yaml, pinctrl-device.yaml]
```

## dts/bindings/gpio/renesas,rzg3s-gpio.yaml
```yaml
# Copyright (c) 2024 Epam Systems
# SPDX-License-Identifier: Apache-2.0

description: |
  Reneses RZ G3S R9A08G045 GPIO controller node.
  It has to be a subnode of the Renesas RZ G3S R9A08G045 SoC pin-controller node
  ("renesas,r9a08g045-pinctrl").

compatible: "renesas,r9a08g045-gpio"

include: base.yaml

properties:
  reg:
    required: true
    description: |
      GPIO amd TINT I/O regions

  reg-names:
    required: true

  "#address-cells":
    const: 1

  "#size-cells":
    const: 0

child-binding:
  description: |
     This bindings describe the RZ G3S GPIO port configuration

  include:
  - name: base.yaml
    property-allowlist:
    - status
    - reg
    - label
  - name: gpio-controller.yaml

  properties:
    reg:
      required: true
      description: |
        GPIO port number. RZ G3S board has a number of GPIO ports that
        are used to identify correct pin number.

    "#gpio-cells":
      const: 2

  gpio-cells:
  - pin
  - flags
```

## dts/bindings/i2c/renesas,riic.yaml
```yaml
# Copyright (c) 2021, IoT.bzh
# Copyright (c) 2023, EPAM Systems
# SPDX-License-Identifier: Apache-2.0

description: Renesas RZ/A2M I2C controller

compatible: "renesas,riic"

include: [i2c-controller.yaml, pinctrl-device.yaml]

properties:
  reg:
    required: true

  interrupts:
    required: true

  clocks:
    required: true

  scl-rising-time-ns:
    type: int
    default: 0
    description: |
      Number of nanoseconds the SCL signal takes to rise; t(r) in the I2C specification.

  scl-falling-time-ns:
    type: int
    default: 0
    description: |
      Number of nanoseconds the SCL signal takes to fall; t(f) in the I2C specification.

  dmas:
    description: |
      Optional TX & RX dma specifiers. Mandatory if defined CONFIG_I2C_RIIC_DMA_DRIVEN
      Each specifier will have a phandle reference to the dmac controller,
      the channel number, slot and config. Use same channel for TX and RX.

      For example dmas for TX, RX on I2C3:
         dmas = <&dma0 2 DMA_RS_INTRIIC_TI3 0>, <&dma0 2 DMA_RS_INTRIIC_RI3 0>;

  dma-names:
    description: |
      Required if the dmas property exists.  This should be "tx" and "rx"
      to match the dmas property.

      For example:
         dma-names = "tx", "rx";
```

## dts/bindings/i2s/renesas,ssif2.yaml
```yaml
# Copyright (c) 2023 EPAM Systems
#
# SPDX-License-Identifier: Apache-2.0

description: Renesas SSIF controller

compatible: "renesas,ssif2"

include: [i2s-controller.yaml, pinctrl-device.yaml]

properties:
  reg:
    required: true

  clocks:
    required: true

  dmas:
    required: true

  clock-stop-enable:
    type: boolean
    description: |
      Turn off audio clock when transmition/reception disabled
```

## dts/bindings/interrupt-controller/renesas,r7s9210-intc.yaml
```yaml
# Copyright (c) 2023 EPAM Systems
# SPDX-License-Identifier: Apache-2.0

description: Renesas r7s9210 interrupt controller

compatible: "renesas,r7s9210-intc"

include: [interrupt-controller.yaml, base.yaml]

properties:
  reg:
    required: true

  map:
    type: array
    required: true

  "#address-cells":
    const: 0

  "#interrupt-cells":
    const: 2

  nmi-edge:
    type: int
    description: |
      Selects whether the falling or rising edge of the interrupt request signal on the
      NMI pin is detected. Possible values IRQ_TYPE_EDGE_FALLING and IRQ_TYPE_EDGE_RISING.
      Note: The NMI pin has a pull-up resistor, so the default level on the pin is high.
    enum: [2, 4]

interrupt-cells:
  - irq
  - flags
```
