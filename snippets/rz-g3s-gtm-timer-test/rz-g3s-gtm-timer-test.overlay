/*
 * Copyright (c) 2024 EPAM Systems
 *
 * SPDX-License-Identifier: Apache-2.0
 */

&gtm0 {
	compatible = "renesas,ostm-r9a08g045-timer", "renesas,ostm-timer";
	status = "okay";
};

&systick {
	status = "disabled";
};
