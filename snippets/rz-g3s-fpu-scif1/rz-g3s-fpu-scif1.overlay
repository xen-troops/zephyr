/*
 * Copyright (c) 2024 EPAM Systems
 *
 * SPDX-License-Identifier: Apache-2.0
 */

/ {
	chosen {
		zephyr,console = &scif1;
		zephyr,shell-uart = &scif1;
	};

};
&scif3 {
	status = "disabled";
};

&scif1 {
	current-speed = <115200>;
	pinctrl-0 = <&scif1_pins>;
	pinctrl-names = "default";
	status = "okay";
};
