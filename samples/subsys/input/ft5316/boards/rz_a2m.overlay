/ {
	aliases {
		dut = &touch;
	};

};

&i2c3 {
	pinctrl-0 = <&i2c3_pins>;
	pinctrl-names = "default";
	status = "okay";
	touch: ft5336@38 {
		compatible = "focaltech,ft5336";
		reg = <0x38>;
		pinctrl-0 = <&irq3_pins>;
		pinctrl-names = "default";
		interrupt-parent = <&intc>;
		interrupts = <3 IRQ_TYPE_EDGE_BOTH>;
		status = "okay";
	};
};
