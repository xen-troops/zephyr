/ {
	chosen {
		zephyr,i2c = &i2c3;
	};
};

&i2c3 {
	pinctrl-0 = <&i2c3_pins>;
	pinctrl-names = "default";
	status = "okay";
	bme280: bme280@76 {
		compatible = "bosch,bme280";
		reg = <0x76>;
		friendly-name = "BME280";
		status = "okay";
	};
};
